# WE2_S register map
Vendor: ARM Ltd.; Series: ARMv8.1-M Mainline; File version: 1.0
CPU: CM55 r1p1, little endian, MPU, FPU, double-precision FPU, DSP, VTOR, 3 interrupt priority bits
Registers are 32-bit, read-write, reset 0x0 unless marked. A register's access mark holds for its fields unless they carry their own. Offsets are from the block's base; [hi:lo] are bit positions; {n}, {i} and the like mark numbered series.

## ADC_LV
Base 0x5200C000
0x00 REG_ADC_EN — ADC module enable
0x04 REG_ADC_PWRGAT — ADC_PWRGAT
{0x8+4i} REG_ADC_AREG{i} (i=0..4) — AREG{i}
0x1C REG_ADC_DBG — DBG
0x20 REG_ADC_XTAL_24M_CFG — XTAL_24M_CFG

## ADC_HV
Base 0x56005000
0x00 REG_ADC_HV_AREG0 — AREG0, Ref to AIP register table (1.8/3.3v input)
0x04 REG_ADC_HV_AREG1 — AREG1, Ref to AIP register table (1.8/3.3v input)
0x08 REG_ADC_HV_EN — LP_ADC_EN, 0: disable , 1: enable
0x0C REG_ADC_HV_IN_SEL — LP_ADC_IN_SEL_HV[1:0]
0x10 REG_ADC_HV_PULL_LOW_EN — Pull low enable
0x14 REG_ADC_HV_PULL_LOW_SEL — PULL_LOW_SEL_HV[1:0]
0x18 REG_ADC_HV_PWR_ON_EN — LV_OFF_HV (Power on enable), 0: VAD/VOD active (0.9v) , 1: VAD/VOD disable (0v)

## CDM
Base 0x55004200
0x00 cdm_en
0x04 cdm_init_map_active_flag
0x08 cdm_en_meta_htpack
0x0C cdm_crop_styx
0x10 cdm_hv
0x14 cdm_fifo_th
0x18 cdm_min_tolerance_react
0x1C cdm_relax_numhtth_erosth
0x20 cdm_ht_vect_th_cons_xy
0x24 cdm_lineframe_end
0x28 cdm_clear_int

## CSIRX — MIPI_RX_CTRL
Base 0x530F8000
0x00 device_config
0x04 soft_reset
0x08 static_cfg
0x10 error_bypass_cfg
0x18 monitor_irqs
0x1C monitor_irqs_mask_cfg
0x20 info_irqs
0x24 info_irqs_mask_cfg
0x28 error_irqs
0x2C error_irqs_mask_cfg
0x40 dphy_lane_control
0x48 dphy_status
0x4C dphy_err_status_irq
0x50 dphy_err_irq_mask_cfg
0x60 integration_debug
0x74 error_debug
0x80 test_generic
{0x100+0x100*i} stream{i}_ctrl (i=0..3)
{0x104+0x100*i} stream{i}_status (i=0..3)
{0x108+0x100*i} stream{i}_data_cfg (i=0..3)
{0x10C+0x100*i} stream{i}_cfg (i=0..3)
{0x110+0x100*i} stream{i}_monitor_ctrl (i=0..3)
{0x114+0x100*i} stream{i}_monitor_frame (i=0..3)
{0x118+0x100*i} stream{i}_monitor_lb (i=0..3)
{0x11C+0x100*i} stream{i}_timer (i=0..3)
{0x120+0x100*i} stream{i}_fcc_cfg (i=0..3)
{0x124+0x100*i} stream{i}_fcc_ctrl (i=0..3)
{0x128+0x100*i} stream{i}_fifo_fill_lvl (i=0..3)
0x900 asf_int_status
0x904 asf_int_raw_status
0x908 asf_int_mask
0x90C asf_int_test
0x910 asf_fatal_nonfatal_select
0x920 asf_sram_corr_fault_status
0x924 asf_sram_uncorr_fault_status
0x928 asf_sram_fault_stats
0x930 asf_trans_to_ctrl
0x934 asf_trans_to_fault_mask
0x938 asf_trans_to_fault_status
0x940 asf_protocol_fault_mask
0x944 asf_protocol_fault_status
0xFFC id_prod_ver

## CSIRX_DPHY — dphy lane control
Base 0x55006000
0x48 CSIRX_DPHY_TUNCATE
0x50 CSIRX_DPHY_REG

## CSITX — MIPI_TX_CTRL
Base 0x53060000
0x00 device_config
0x04 status
0x08 irq
0x0C irq_mask
0x10 dphy_irq
0x14 dphy_irq_mask
0x20 tx_conf
0x24 wait_burst_time
0x28 dphy_cfg
0x2C dphy_clk_wakeup
0x30 dphy_ulps_wakeup
0x34 dphy_cfg1
0x38 dphy_status
{0x40+4i} vc{i}_cfg (i=0..15)
{0x80+8i} dt{i}_cfg (i=0..15)
{0x84+8i} dt{i}_format (i=0..15)
{0x100+4i} stream_if_{i}_cfg (i=0..3)
0x200 epd_en_ssp
0x204 epd_op_slp
0x208 epd_clkidlehs_min
0xD00 debug_cfg
0xD04 debug_ln_fsm
0xD08 debug_clk_ln_fsm
0xD0C debug_data_ln_fsm
{0xD10+4i} debug_prot{i}_fsm (i=0..3)
0xDF8 test_generic_status
0xDFC test_generic_ctrl
0xE00 asf_int_status
0xE04 asf_int_raw_status
0xE08 asf_int_mask
0xE0C asf_int_test
0xE10 asf_fatal_nonfatal_select
0xE20 asf_sram_corr_fault_status
0xE24 asf_sram_uncorr_fault_status
0xE28 asf_sram_fault_stats
0xE30 asf_trans_to_ctrl
0xE34 asf_trans_to_fault_mask
0xE38 asf_trans_to_fault_status
0xE40 asf_protocol_fault_mask
0xE44 asf_protocol_fault_status
0xFFC id_prod_ver

## DMA0
Base 0x50000000
Same registers: DMA1 0x51000000, DMA2 0x51800000, DMA3 0x51810000
0x00 DMAC_INT_STATUS
0x04 DMAC_INT_TC_STATUS
0x08 DMAC_INT_TC_CLR
0x0C DMAC_INT_ERR_STATUS
0x10 DMAC_INT_ERR_CLR
0x14 DMAC_RAW_INT_TC_STATUS
0x18 DMAC_RAW_INT_ERR_STATUS
0x1C DMAC_ENABLE_CHANNEL
0x20 DMAC_SOFT_B_REQ
0x24 DMAC_SOFT_S_REQ
0x28 DMAC_LAST_SOFT_B_REQ
0x2C DMAC_LAST_SOFT_S_REQ
0x30 DMAC_CONFIGURATION
0x34 DMAC_SYNC
{0x100+0x20*i} DMAC_CH{i}_SRC_ADDR (i=0..7)
{0x104+0x20*i} DMAC_CH{i}_DEST_ADDR (i=0..7)
{0x108+0x20*i} DMAC_CH{i}_LLI (i=0..7)
{0x10C+0x20*i} DMAC_CH{i}_CONTROL (i=0..7)
{0x110+0x20*i} DMAC_CH{i}_CONFIGURATION (i=0..7)
{0xFE0+4i} DMAC_PERIPHID{i} (i=0..3)
{0xFF0+4i} DMAC_PCELLID{i} (i=1..3)

## Notices in the file
Copyright (C) 2012 - 2020 Arm Limited. All rights reserved.
Purpose: System Viewer Description (SVD) Example (Schema Version 1.1)
This is a description of a none-existent and incomplete device
for demonstration purposes only.
Redistribution and use in source and binary forms, with or without
modification, are permitted provided that the following conditions are met:
- Redistributions of source code must retain the above copyright
notice, this list of conditions and the following disclaimer.
- Redistributions in binary form must reproduce the above copyright
notice, this list of conditions and the following disclaimer in the
documentation and/or other materials provided with the distribution.
- Neither the name of ARM nor the names of its contributors may be used
to endorse or promote products derived from this software without
specific prior written permission.
THIS SOFTWARE IS PROVIDED BY THE COPYRIGHT HOLDERS AND CONTRIBUTORS "AS IS"
AND ANY EXPRESS OR IMPLIED WARRANTIES, INCLUDING, BUT NOT LIMITED TO, THE
IMPLIED WARRANTIES OF MERCHANTABILITY AND FITNESS FOR A PARTICULAR PURPOSE
ARE DISCLAIMED. IN NO EVENT SHALL COPYRIGHT HOLDERS AND CONTRIBUTORS BE
LIABLE FOR ANY DIRECT, INDIRECT, INCIDENTAL, SPECIAL, EXEMPLARY, OR
CONSEQUENTIAL DAMAGES (INCLUDING, BUT NOT LIMITED TO, PROCUREMENT OF
SUBSTITUTE GOODS OR SERVICES; LOSS OF USE, DATA, OR PROFITS; OR BUSINESS
INTERRUPTION) HOWEVER CAUSED AND ON ANY THEORY OF LIABILITY, WHETHER IN
CONTRACT, STRICT LIABILITY, OR TORT (INCLUDING NEGLIGENCE OR OTHERWISE)
ARISING IN ANY WAY OUT OF THE USE OF THIS SOFTWARE, EVEN IF ADVISED OF THE
POSSIBILITY OF SUCH DAMAGE.
