# WE2_S_NS register map
Vendor: ARM Ltd.; Series: ARMv8.1-M Mainline; File version: 1.0
CPU: CM55 r1p1, little endian, MPU, FPU, double-precision FPU, DSP, VTOR, 3 interrupt priority bits
Registers are 32-bit, read-write, reset 0x0 unless marked. A register's access mark holds for its fields unless they carry their own. Offsets are from the block's base; [hi:lo] are bit positions; {n}, {i} and the like mark numbered series.

## DMA0
Base 0x50000000
Same registers: DMA0_NS 0x40000000, DMA1_NS 0x41000000, DMA2_NS 0x41800000, DMA3_NS 0x41810000, DMA1 0x51000000, DMA2 0x51800000, DMA3 0x51810000
0x00 DMAC_INT_STATUS
0x04 DMAC_INT_TC_STATUS
0x08 DMAC_INT_TC_CLR
0x0C DMAC_INT_ERR_STATUS
0x10 DMAC_INT_ERR_CLR
0x14 DMAC_RAW_INT_TC_STATUS
0x18 DMAC_RAW_INT_ERR_STATUS
0x1C DMAC_ENABLE_CHANNEL
0x20 DMAC_SOFT_B_REQ
0x24 DMAC_SOFT_S_REQ
0x28 DMAC_LAST_SOFT_B_REQ
0x2C DMAC_LAST_SOFT_S_REQ
0x30 DMAC_CONFIGURATION
0x34 DMAC_SYNC
{0x100+0x20*i} DMAC_CH{i}_SRC_ADDR (i=0..7)
{0x104+0x20*i} DMAC_CH{i}_DEST_ADDR (i=0..7)
{0x108+0x20*i} DMAC_CH{i}_LLI (i=0..7)
{0x10C+0x20*i} DMAC_CH{i}_CONTROL (i=0..7)
{0x110+0x20*i} DMAC_CH{i}_CONFIGURATION (i=0..7)
{0xFE0+4i} DMAC_PERIPHID{i} (i=0..3)
{0xFF0+4i} DMAC_PCELLID{i} (i=1..3)

## DP
Base 0x55004300
Same registers: DP_HSC_NS 0x43100300, DP_NS 0x45004300, DP_HSC 0x53100300
0x00 REG_DP_MUX — REG_DP_MUX[13:0]
0x04 REG_DP_INT_MSK — REG_DP_INT_MSK[7:0]
0x0C REG_DP_INT_STATUS — REG_DP_INT_STATUS[7:0]

## DP_RGB2YUV
Base 0x55004A00
Same registers: DP_CSC_NS 0x45004900, DP_RGB2YUV_NS 0x45004A00, DP_CSC 0x55004900
0x00 CFG

## EDM
Base 0x55004C00
Same registers: EDM_NS 0x45004C00
0x00 EDM_CRC_CFG
{0x4+4i} EDM_CRC_CH{i} (i=0..2)
0x10 EDM_CRC_CONV
0x14 REG_EDM_CTRL
0x18 REG_EDM_MASK
0x1C REG_EDM_VTH
0x20 REG_EDM_CON_VTH
0x24 REG_EDM_HTH
0x28 REG_EDM_CON_HTH
{0x2C+4i} REG_EDM_CH{i}_DE_TH (i=0..2)
0x38 REG_EDM_HFP_TH
0x3C REG_EDM_HBP_TH
0x40 REG_EDM_V_H_D_F_SEL
0x44 REG_EDM_DBG_SEL
0x48 REG_EDM_CON_FP_BP
0x4C REG_EDM_CON_VB_HB
0x50 REG_EDM_STATUS
0x54 REG_EDM_INT_CLR
0x58 REG_WDT_EN
{0x58+4i} REG_WDT{i}_TH (i=1..3)
{0x68+4i} REG_EDM_CH{i}_DECNT (i=0..2)
0x74 REG_EDM_CONV_DECNT
{0x74+4i} REG_WDT{i}_CNT (i=1..3)
0x84 REG_EDM_FRAMECNT
0x88 REG_EDM_HFP_CNT
0x8C REG_EDM_HBP_CNT
0x90 REG_EDM_HTOTAL_CNT

## GPIO0
Base 0x54006000
Same registers: GPIO0_NS 0x44006000, GPIO1_NS 0x44007000, GPIO2_NS 0x44008000, GPIO3_NS 0x44009000, GPIO4_NS 0x46002000, GPIO5_NS 0x46103000, GPIO1 0x54007000, GPIO2 0x54008000, GPIO3 0x54009000, GPIO4 0x56002000, GPIO5 0x56103000
0x00 int_status
0x400 GPIODIR — Direction (R/W), 0: input, 1: output
0x404 GPIOIS — Interrupt Sense (R/W), 0: edge, 1: level
0x408 GPIOIBE — Interrupt Both Edge (R/W), 0: single, 1: both
0x40C GPIOIEV — Interrupt Event (R/W), 0: falling/low, 1: rising/high
0x410 GPIOIE — Interrupt Mask (R/W), 0: disable interrupt, 1: enable interrupt
0x414 GPIORIS — Raw Interrupt Status (R)
0x418 GPIOMIS — Mask Interrupt Status (R)
0x41C GPIOIC — Interrupt Clear (W), 1: clear, 0: no effect

## AUTOI2C_MST
Base 0x56008000
Same registers: AUTOI2C_MST_NS 0x46008000
0x00 mst2sen_en
0x04 mst2sen_type
0x08 mst2sen_trig_sw
0x0C mst2sen_stop_sw
0x10 mst2sen_trig
0x14 mst2sen_stop
0x18 mst2sen_speed
0x1C mst2sen_slave_id
0x20 mst2sen_trig_int_loc
0x24 mst2sen_trig_int_delay
0x28 mst2sen_stop_int_loc
0x2C mst2sen_stop_int_delay
0x30 trig_cmd_num
0x34 trig_cmd_byte_num
0x40 trig_delay_01
0x44 trig_delay_12
0x48 trig_delay_23
0x4C trig_delay_34
{0x48+8i} trig_cmd{i}_byte_4_1 (i=1..4)
0x70 stop_cmd_num
0x74 stop_cmd_byte_num
0x80 stop_delay_01
0x84 stop_delay_12
0x8C stop_delay_34
{0x88+8i} stop_cmd{i}_byte_4_1 (i=1..4)
0xB0 int_mask
0xB4 int_mask_status
0xB8 int_raw_status
0xBC noack_int_clr
0xC0 mst2sen_status
0xC4 mst2sen_noackstatus — i2c master no ack state

## I2S_HOST
Base 0x54002000
Same registers: I2S_HOST_NS 0x44002000, I2S_SLAVE_NS 0x4400B000, I2S_SLAVE 0x5400B000
0x00 IER — Enable Register
0x04 IRER — I2S Receiver Block Enable Register
0x08 ITER — I2S Transmitter Block Enable Register
0x0C CER — Clock Enable Register
0x10 CCR — Clock Configuration Register
0x14 RXFFR — Receiver Block FIFO Register
0x18 TXFFR — Transmitter Block FIFO Register
{0x20+0x40*i} LTHR{i} (i=0..3) — Left Transmit Holding Register {i}
{0x24+0x40*i} RTHR{i} (i=0..2) — Right Transmit Holding Register {i}
{0x28+0x40*i} RER{i} (i=0..3) — Receive Enable Register {i}
{0x2C+0x40*i} TER{i} (i=0..3) — Transmit Enable Register {i}
{0x30+0x40*i} RCR{i} (i=0..3) — Receive Configuration Register {i}
{0x34+0x40*i} TCR{i} (i=0..3) — Transmit Configuration Register {i}
{0x38+0x40*i} ISR{i} (i=0..3) — Interrupt Status Register {i}
{0x3C+0x40*i} IMR{i} (i=0..3) — Interrupt Mask Register {i}
{0x40+0x40*i} ROR{i} (i=0..3) — Receive Overrun Register {i}
{0x44+0x40*i} TOR{i} (i=0..3) — Transmit Overrun Register {i}
{0x48+0x40*i} RFCR{i} (i=0..3) — Receive FIFO Configuration Register {i}
{0x4C+0x40*i} TFCR{i} (i=0..3) — Transmit FIFO Configuration Register {i}
{0x50+0x40*i} RFF{i} (i=0..3) — Receive FIFO Flush {i}
{0x54+0x40*i} TFF{i} (i=0..3) — Transmit FIFO Flush {i}
0xE4 RTHR3 — Right Transmit Holding Register 2
0x1C0 RXDMA — Receiver Block DMA Register
0x1C4 RRXDMA — Reset Receiver Block DMA Register
0x1C8 TXDMA — Transmitter Block DMA Register
0x1CC RTXDMA — Reset Transmitter Block DMA Register
0x1F0 I2S_COMP_PARAM_2 — Component Parameter 2 Register
0x1F4 I2S_COMP_PARAM_1 — Component Parameter 1 Register
0x1F8 I2S_COMP_VERSION — Component Version ID
0x1FC I2S_COMP_TYPE — Component Type
0x200 DMACR — DMA Control Register
