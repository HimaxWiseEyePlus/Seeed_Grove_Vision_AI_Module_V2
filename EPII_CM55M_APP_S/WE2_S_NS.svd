# WE2_S_NS register map
Vendor: ARM Ltd.; Series: ARMv8.1-M Mainline; File version: 1.0
CPU: CM55 r1p1, little endian, MPU, FPU, double-precision FPU, DSP, VTOR, 3 interrupt priority bits
Registers are 32-bit, read-write, reset 0x0 unless marked. A register's access mark holds for its fields unless they carry their own. Offsets are from the block's base; [hi:lo] are bit positions.

## SCU_HSC
Base 0x53070000
Same registers: SCU_HSC_NS 0x43070000
0x808 SCU_U55_AXIMSC_IDAU
0x80C SCU_U55_AXIMSC_CFG
0x810 SCU_DMA0_AHBMSC_IDAUCFG
0x814 SCU_DMA1_AHBMSC_IDAUCFG
0x82C SCU_I3CHC_MSC_IDAUCFG
0x830 SCU_SDIO_MSC_IDAUCFG
0x840 SCU_DWC_PPC_CFG_APNS
0x844 SCU_DWC_PPC_CFG_INT
0x848 SCU_ISP_PPC_CFG_APNS
0x84C SCU_ISP_PPC_CFG_INT
0x858 SCU_AHB1M4_PPC_CFG_APNS
0x85C SCU_AHB1M4_PPC_CFG_INT
0x880 SCU_APB2_PPC_CFG_AP
0x884 SCU_APB2_PPC_CFG_NS
0x888 SCU_APB2_PPC_CFG_INT
0x8A0 SCU_ROM_PPC_CFG_APNSINT
0x8A4 SCU_QOSPI_MPC_CFG_APNSINT
0xA00 SCU_CORESIGHT_DBG_EN
0xB00 SCU_ISP_XIP_SPICACHE
0xB04 SCU_OSPI_XIP_EN_SLAVE
0xB08 SCU_OSPI_RESETN
0xB10 SCU_SDIO_HWINIT_ITCFVAL

## SCU_LSC
Base 0x52001000
Same registers: SCU_LSC_NS 0x42001000
0x100 SCU_SEN_CSW01_PCLK_D01_PINMUX
0x104 SCU_SEN_D27_FLVALID_PINMUX
0x108 SCU_SDIO_PINMUX
0x10C SCU_SSPIS_SW_PINMUX
0x110 SCU_SSPIM_PINMUX
0x114 SCU_GPIO012_PINMUX
0x118 SCU_UART0_PINMUX
0x11C SCU_PDM_PINMUX
0x120 SCU_SWDIO_OSPI_I2CM_UART2
0x130 SCU_I2CSLV_I3CSLV_SHARE_EN
0x300 SCU_CM55S_RESET_MASK
0x400 SCU_I2S_MODE
0x404 SCU_PDM_IP
0x408 SCU_REG_VMUTE_CTRL
0x40C SCU_REG_OSPI_RXDS_CTRL
0x410 SCU_REG_SEN_MCLK_CTRL_SRC_SEL
0x500 SCU_REG_AIP_DBG_MUX
0x818 SCU_DMA2_M1_AHBMSC_IDAUCFG
0x81C SCU_DMA2_M2_AHBMSC_IDAUCFG
0x820 SCU_DMA3_M1_AHBMSC_IDAUCFG
0x824 SCU_DMA3_M2_AHBMSC_IDAUCFG
0x850 SCU_AHB3_PPC_CFG_APNS
0x854 SCU_AHB3_PPC_CFG_INT
0x860 SCU_APB0NS_PPC_CFG_APNS
0x864 SCU_APB0NS_PPC_CFG_INT
0x868 SCU_APB0PS_PPC_CFG_APNS
0x86C SCU_APB0PS_PPC_CFG_INT
0x8A4 SCU_SRAM2_MPC_CFG_APNSINT
0xB0C SCU_VAD_D_PCM_DATA_SEL

## SENCTRL
Base 0x55005000
Same registers: SENCTRL_NS 0x45005000
0x00 SENCTRL_MODE
0x04 SENCTRL_T_PRE_POST
0x08 SENCTRL_NFRAME
0x0C SENCTRL_FVLD_WDT
0x10 SENCTRL_TRIG_LOW_LINELENGTH
0x14 SENCTRL_STATE

## SENCTRL_LSC
Base 0x5200E000
Same registers: SENCTRL_LSC_NS 0x4200E000
0x00 SENCTRL_MODE
0x04 SENCTRL_T_PRE_POST
0x08 SENCTRL_NFRAME
0x0C SENCTRL_FVLD_WDT
0x10 SENCTRL_TRIG_LOW_LINELENGTH
0x14 SENCTRL_STATE

## QSPI_M — QSPI_M (spi 0)
Base 0x3A000000
Same registers: QSPI_M_NS 0x2A000000, OSPI_M_NS 0x2C000000, OSPI_M 0x3C000000, SSPI_M_NS 0x40800000, SSPI_S_NS 0x40810000, SSPI_M 0x50800000, SSPI_S 0x50810000
0x00 CTRLR0 — SPI Control Register 0
0x04 CTRLR1 — SPI Control Register 1
0x08 SSIENR — SPI Microwire Control Register
0x0C MWCR — SPI Slave Enable Register
0x10 SER — SPI Baud Rate Select Register
0x14 BAUDR — SPI Baud Rate Select Register
0x18 TXFTLR — SPI Transmit FIFO Threshold Level Register
0x1C RXFTLR — SPI Receive FIFO Threshold Level Register
0x20 TXFLR — SPI Transmit FIFO Level Register
0x24 RXFLR — SPI Receive FIFO Level Register
0x28 SR — SPI Status Register
0x2C IMR — SPI Interrupt Mask Register
0x30 ISR — SPI Interrupt Status Register
0x34 RISR — SPI Raw Interrupt Status Register
0x38 TXOICR — SPI Receive FIFO Overflow Interrupt Clear Register
0x3C RXOICR — SPI Receive FIFO Underflow Interrupt Clear Register
0x40 RXUICR — SPI Multi-Master Interrupt Clear Register
0x44 MSTICR — SPI Multi-Master Interrupt Clear Register
0x48 ICR — SPI Interrupt Clear Register
0x4C DMACR — DMA Control Register
0x50 DMATDLR — DMA Transmit Data Level
0x54 DMARDLR — DMA Receive Data Level
0x58 IDR — SPI Identification Register
0x5C SSI_VER_ID reset 0x3332322A — SPI CoreKit ID Register (Value after Reset : 0x3332322A)
0x60 DATAREG — SPI DATA Register for both Read and Write
0xF0 RX_SAMPLE_DLY — RxD Sample Delay Register
0xF4 SPI_CTRLR0
0xF8 DDR_DRIVE_EDGE
0xFC XIP_MODE_BITS
0x100 XIP_INCR_INST
0x104 XIP_WRAP_INST
0x108 XIP_CTRL
0x10C XIP_SER
0x110 XRXOICR
0x114 XIP_CNT_TIME_OUT
0x140 XIP_WRITE_INCR_INST
0x144 XIP_WRITE_WRAP_INST
0x148 XIP_WRITE_CTRL
